## config/west.yml
```yaml
# manifest:
#   remotes:
#     - name: zmkfirmware
#       url-base: https://github.com/zmkfirmware
#     - name: infused-kim
#       url-base: https://github.com/infused-kim
#   projects:
#     - name: zmk
#       remote: infused-kim
#       revision: sofle
#       import: app/west.yml
#   self:
#     path: config

manifest:
  remotes:
    - name: zmkfirmware
      url-base: https://github.com/zmkfirmware
    - name: caksoylar
      url-base: https://github.com/caksoylar
  projects:
    - name: zmk
      remote: caksoylar
      revision: fix-battery-reporting
      import: app/west.yml
  self:
    path: config
```
